## configs/shanlingq1_defconfig
```kconfig
BR2_mipsel=y
BR2_mips_xburst=y
BR2_MIPS_SOFT_FLOAT=n
BR2_GLOBAL_PATCH_DIR="board/rockbox/patches"
BR2_LINUX_KERNEL=y
BR2_LINUX_KERNEL_USE_DEFCONFIG=y
BR2_LINUX_KERNEL_DEFCONFIG="shanlingq1"
BR2_LINUX_KERNEL_DTS_SUPPORT=y
BR2_LINUX_KERNEL_DTB_IS_SELF_BUILT=y
BR2_LINUX_KERNEL_INTREE_DTS_NAME="ingenic/shanlingq1.dts"
BR2_LINUX_KERNEL_UIMAGE=y
BR2_LINUX_KERNEL_GZIP=y
# FIT support needed to avoid kernel build error
BR2_PACKAGE_HOST_UBOOT_TOOLS_FIT_SUPPORT=y
```
